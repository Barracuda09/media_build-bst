## linux/drivers/media/pci/smipcie/Kconfig
```kconfig
config DVB_SMIPCIE
	tristate "SMI PCIe DVBSky cards"
	depends on DVB_CORE && PCI && I2C
	select I2C_ALGOBIT
	select DVB_DVBSKY_M88DS3103 if MEDIA_SUBDRV_AUTOSELECT
	select DVB_DVBSKY_M88RS6000 if MEDIA_SUBDRV_AUTOSELECT
	select DVB_SIT2 if MEDIA_SUBDRV_AUTOSELECT
	depends on RC_CORE
	help
	  Support for cards with SMI PCIe bridge:
	  - DVBSky S950 V3
	  - DVBSky S952 V3
	  - DVBSky T9580 V3

	  Say Y or M if you own such a device and want to use it.
	  If unsure say N.
```
